#include <behaviors.dtsi>
#include <dt-bindings/zmk/keys.h>
#include <dt-bindings/zmk/bt.h>

// Keycodes: https://zmk.dev/docs/keymaps/list-of-keycodes

/ {  
    keymap {
        compatible = "zmk,keymap";

        default_layer {
            bindings = <
                &mo 1   &kp KP_N0   &kp KP_N1   &kp KP_N2   &kp KP_N3   &kp KP_N4   &kp KP_N5   &kp KP_N6   &kp KP_N7   &kp KP_N8   &kp KP_N9   &kp A   &kp B   &kp C   &kp D   &kp E
            >;
            sensor-bindings = <&inc_dec_kp UP DOWN>;
        }; 
        
        bt_layer {
            bindings = <
                &none   &bootloader   &bt BT_SEL 0   &bt BT_SEL 1   &bt BT_CLR   &none   &none   &none   &none   &none   &none   &none   &none   &none   &none   &none
            >;
        };
    };
};

