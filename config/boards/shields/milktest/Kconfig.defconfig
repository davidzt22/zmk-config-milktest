## config/boards/shields/milktest/Kconfig.defconfig
```kconfig
if SHIELD_MILKTEST

# Name must be less than 16 characters long!
config ZMK_KEYBOARD_NAME
    default "milk test"

endif
```

## config/boards/shields/milktest/Kconfig.shield
```kconfig
# No whitespace after the comma or in the keyboard name!
config SHIELD_MILKTEST
    def_bool $(shields_list_contains,milktest)

config SHIELD_MILKTEST_DONGLE
    def_bool $(shields_list_contains,milktest_dongle)
```
